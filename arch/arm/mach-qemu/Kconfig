## arch/arm/mach-qemu/Kconfig
```kconfig
if ARCH_QEMU || ARCH_QEMU64

config SYS_VENDOR
	default "emulation"

endif

if ARCH_QEMU

config SYS_BOARD
	default "qemu-arm"

config SYS_CONFIG_NAME
	default "qemu-arm"

endif

if ARCH_QEMU64

config SYS_BOARD
	default "qemu-arm64"

config SYS_CONFIG_NAME
	default "qemu-arm64"

endif
```

## configs/qemu_arm64_defconfig
```kconfig
CONFIG_ARM=y
CONFIG_ARCH_QEMU64=y
CONFIG_IDENT_STRING="\nQEMU Arm64"
CONFIG_DISTRO_DEFAULTS=y
CONFIG_EFI_LOADER=y
# CONFIG_DISPLAY_CPUINFO is not set
# CONFIG_DISPLAY_BOARDINFO is not set
# CONFIG_CMD_IMLS is not set
CONFIG_CMD_MEMINFO=y
CONFIG_CMD_GPT=y
CONFIG_ENV_IS_FS=y
CONFIG_AHCI=y
CONFIG_CMD_PCI=y
CONFIG_CMD_USB=y
CONFIG_OF_BOARD=y
CONFIG_AHCI_PCI=y
CONFIG_BLK=y
# CONFIG_MMC is not set
CONFIG_DM_ETH=y
CONFIG_E1000=y
CONFIG_NVME=y
CONFIG_PCI=y
CONFIG_DM_PCI=y
CONFIG_PCIE_ECAM_GENERIC=y
CONFIG_SCSI=y
CONFIG_DM_SCSI=y
CONFIG_SYSRESET=y
CONFIG_SYSRESET_PSCI=y
CONFIG_USB=y
CONFIG_DM_USB=y
CONFIG_USB_EHCI_HCD=y
CONFIG_USB_EHCI_PCI=y
```
